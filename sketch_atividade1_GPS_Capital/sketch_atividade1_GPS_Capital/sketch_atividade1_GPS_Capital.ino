#include <SoftwareSerial.h>
#include <TinyGPS.h>

SoftwareSerial conexao(10, 11); /*RX TX*/
TinyGPS dadosGps;



void setup() {
  conexao.begin(9600);
  Serial.begin(9600);
  
  Serial.println("GPS recebendo sinal, aguarde")

}

void loop() {
  bool recebido = false;
  
  /*Recebe os dados do GPS e armazena*/
  while(conexao.available()){
    char dadoConexao = conexao.read();
    recebido = dadoGps.encode(dadoConexao);
      
  }
  
  if(recebido){
    
  /*Latitude e Longitude*/
    long lati, longi;
    unsigned long idadeInfo;/*Variavel que representa quanto tempo faz que a informação foi gerada pelo satélite*/
    dadoGps.get_positon(&lati, &longi,&idadeInfo);/*Atualiza os dados */
    
    /*Validando as informações*/
    
    if(lati != TinyGPS :: GPS_INVALID_F_ANGLE){
      Serial.print("Latitude: ");
      Serial.print(float(lati)/100000,6);
      
    }
    
    if(longi != TinyGPS :: GPS_INVALID_F_ANGLE){
      Serial.print("Longitude: ");
      Serial.print(float(longi)/100000,6);
    }
    
    if(idadeInfo != TinyGPS :: GPS_INVALID_F_ANGLE){
      Serial.print("Idade da Informação (ms)");
      Serial.print(idadeInfo);
      
    }
    
    
    /*Altitude*/
    
    float altitudeGPS;
    altitudeGPS = dadosGps.f_altitude();
    
    /*validando as informações*/
    if((altitudeGPS != TinyGPS :: GPS_INVALID_F_ANLGLE) && (altitudeGPS != 1000000)){
      Serial.print("Altitude(cm) :")
      Serial.print(altitudeGPS);
      
    }
    
    /*Sentido de deslocamento em centesimos de grau*/
    
    unsigned long sentido;
    sentido = dadosGps.course();
    
    Serial.print("Sentido (grau)");
    Serial.print(sentido);
    
    /*Validando a precisão do satélite*/
    
    unsigned long precisaoSatelite;
    precisaoSatelite = dadosGps.hdop();
    
    if(precisaoSatelite != TinyGPS :: GPS_INVALID_HDOP){
      Serial.print("Precisão em centésimos de sengundos : ");
      Serial.print(precisaoSatelite);
        
      
    }
    
    
    
    
    
  }

}
