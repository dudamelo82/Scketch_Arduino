/*LoRa Send and Receive*/

#include<SPI.h>/*comunicação serial*/
#include<LoRa.h>/*comunicação wifi*/
#include<Wire.h>/*comunicação i2c*/
#include "SSD1306.h"/*comunicação com o display*/

#define MASTER
/*Definição dos pinos*/
#define SCK 5
#define MISO 19
#define MOSI 27
#define SS 18
#define RST 14
#define DI00 26 /*Interrompe a requisição*/

#define BAND 433E6 /*Frequencia de radio - Podemos usar também a 915E6 e a 868E6*/

const String GETDATA = "getData"
const String SETDATA = "setData"

SSD1306(0X3C,4,15);

void setupDisplay(){
  pinMode(16, OUTPUT);
  digitalWrite(16,LOW);
  digitalWrite(16,HIGH);
  
  display.init();
  display.flipScreenVertically();
  display.setFont(Arial_Plain_10);
  display.setTextAligment(TEXT_ALIGN_LEFT);
  
  
}

void setupLoRa() {
  
  SPI.begin(SCK,MISO,MOSI,SS);
  LoRa.setPins(SS,RST,DI00);
  
  if(!LoRa.begin(BAND,true)){
    display.clear();
    display.drawString(0,0,"Erro ao iniciar o LoRa");
    display.display();
    while(1);
  }
  LoRa.enableCrc();
  
  LoRa.receive();
  
}

void setup(){
  Serial.begin(115200);
  setupDisplay();
  setupLoRa();
  
  display.clear();
  display.drawString(0,0,"Master");
  display.display();
}


void loop() {
  
    if(milis()lastSendTime > INTERVAL){
      lastSendTime = milis();
      send();
    }
  receive();
}
